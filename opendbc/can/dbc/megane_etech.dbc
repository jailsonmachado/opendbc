VERSION ""

NS_ :

BS_:

BU_: ADAS CAMERA EPS

BO_ 427 ADAS_STATUS: 48 ADAS
 SG_ CHECKSUM : 32|8@1+ (1,0) [0|255] "" EPS
 SG_ COUNTER : 40|4@1+ (1,0) [0|15] "" EPS
 SG_ STEER_TORQUE_SENSOR : 48|16@0- (1,0) [-5000|5000] "" EPS
 SG_ STEER_ANGLE : 64|16@1- (0.1,0) [-720|720] "deg" EPS
 SG_ STEER_RATE : 80|16@1- (0.01,0) [-327|327] "deg/s" EPS

BO_ 550 WHEEL_SPEEDS: 48 EPS
 SG_ WHEEL_SPEED_FL : 55|16@0+ (0.01,0) [0|300] "km/h" ADAS
 SG_ WHEEL_SPEED_FR : 71|16@0+ (0.01,0) [0|300] "km/h" ADAS
 SG_ WHEEL_SPEED_RL : 231|16@0+ (0.01,0) [0|300] "km/h" ADAS
 SG_ WHEEL_SPEED_RR : 247|16@0+ (0.01,0) [0|300] "km/h" ADAS

BO_ 303 GAS_PEDAL: 12 EPS
 SG_ GAS_PEDAL_POS : 16|8@1+ (0.4,0) [0|100] "%" ADAS

BO_ 1475 ADAS_CAM_STATE: 48 ADAS
 SG_ ACC_ACTIVE : 1|1@1+ (1,0) [0|1] "" EPS

BO_ 1479 ADAS_CAM_MISC: 48 ADAS
 SG_ STANDSTILL : 0|1@1+ (1,0) [0|1] "" EPS

BO_ 768 CRUISE_STATE: 8 ADAS
 SG_ BRAKE_PRESSED : 28|1@1+ (1,0) [0|1] "" EPS
 SG_ CRUISE_ACTIVE : 24|1@1+ (1,0) [0|1] "" EPS
