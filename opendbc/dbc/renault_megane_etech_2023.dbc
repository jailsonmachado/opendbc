VERSION ""

NS_ :

BS_ :

BU_ : ADAS CAMERA EPS

BO_ 427 ADAS_STATUS: 48 ADAS
 SG_ CHECKSUM : 32|8@1+ (1,0) [0|255] "" EPS
 SG_ COUNTER : 40|4@1+ (1,0) [0|15] "" EPS
 SG_ STEER_TORQUE_SENSOR : 48|16@1- (1,0) [-32768|32767] "" EPS
 SG_ STEER_ANGLE : 64|16@1- (0.1,0) [-500|500] "deg" EPS

BO_ 550 WHEEL_SPEEDS: 48 EPS
 SG_ WHEEL_SPEED_FL : 56|16@1+ (0.01,0) [0|300] "km/h" ADAS
 SG_ WHEEL_SPEED_FR : 72|16@1+ (0.01,0) [0|300] "km/h" ADAS

BO_ 303 GAS_PEDAL: 12 EPS
 SG_ GAS_PEDAL_POS : 16|8@1+ (0.4,0) [0|100] "%" ADAS
